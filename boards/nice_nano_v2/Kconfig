## boards/nice_nano_v2/Kconfig
```kconfig
if BOARD_NICE_NANO_V2

config BOARD
	default "nice_nano_v2"

config ZMK_BATTERY_REPORTING
	default y

config ZMK_BLE_PASSKEY_ENTRY
	default y

config ZMK_BLE_CLEAR_BONDS_ON_START
	default y

endif
```

## boards/nice_nano_v2/Kconfig.defconfig
```kconfig
if BOARD_NICE_NANO_V2

config BOARD
	default "nice_nano_v2"

config SOC
	default "nrf52840_qiaa"

config ZMK_USB
	default y

endif
```

## boards/shields/ldk_skeletor/Kconfig.shield
```kconfig
config SHIELD_LDK_SKELETOR_LEFT
    def_bool $(shields_list_contains,ldk_skeletor_left)

config SHIELD_LDK_SKELETOR_RIGHT
    def_bool $(shields_list_contains,ldk_skeletor_right)
    
```
